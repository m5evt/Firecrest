/* 
 * Copyright 2021 m5evt
 * 
 * This is free software; you can redistribute it and/or modify
 * it under the terms of the GNU General Public License as published by
 * the Free Software Foundation; either version 3, or (at your option)
 * any later version.
 * 
 * This software is distributed in the hope that it will be useful,
 * but WITHOUT ANY WARRANTY; without even the implied warranty of
 * MERCHANTABILITY or FITNESS FOR A PARTICULAR PURPOSE.  See the
 * GNU General Public License for more details.
 * 
 * You should have received a copy of the GNU General Public License
 * along with this software; see the file COPYING.  If not, write to
 * the Free Software Foundation, Inc., 51 Franklin Street,
 * Boston, MA 02110-1301, USA.
 *
 */
 
#include <stdlib.h>

#include "firecrest.h"
#include "ssd1306.h"
#include "display.h"



static void drawNumberBig(int bigNum, int offset);
static void drawNumberSmall(int smallNum, int offset, int offsetRow);
static void drawDot(int offset);
static void drawVSWRtoOne(void);

//ICON 45x16
// Per http://www.nongnu.org/avr-libc/user-manual/pgmspace.html
const uint8_t stateIcons[NUMSTATES][ICONWIDTHbits*ICONROWSbytes] PROGMEM = { 
{0x0 , 0x0 , 0x0 , 0x0 , 0x0 , 0x0 , 0x0 , 0x0 , 0x00 , 0x00 , 0x00 , 0x00 , 0x00 ,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 0x0 , 0x0}, //Freq
{0x0 , 0x0 , 0x0 , 0x0 , 0x0 , 0x0 , 0x0 , 0x0 , 0x8 , 0xf8 , 0x88 , 0x88 , 0x88 ,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 0x80 , 0x80}, //RIT
{0x0 , 0x0 , 0x0 , 0x0 , 0x0 , 0x0 , 0x0 , 0x0 , 0x8 , 0x78 , 0xc8 , 0x0 , 0x0 ,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 0x80 , 0x80}, //VOL
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{0x0 , 0x0 , 0x0 , 0x0 , 0x0 , 0x8 , 0xf8 , 0x88 , 0x88 , 0x88 , 0xf8 , 0x70 , 0x0 ,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 0x83 , 0x80} // BAND
};

const uint8_t bigNumbers[11][BIGNUMbits*BIGNUMbytes] PROGMEM = { 
{0x0 , 0xfe , 0xff , 0x3 , 0x3 , 0x3 , 0x3 , 0x3 , 0x3 , 0x3 , 0x3 , 0x3 , 0xff ,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 0x7f , 0x0}, 			//0
{0x0 , 0x0 , 0x0 , 0x0 , 0x0 , 0x0 , 0x0 , 0x0 , 0x0 , 0x0 , 0x0 , 0x0 , 0xff ,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 0x7f , 0x0 }, 					  		//1
{0x0 , 0x2 , 0x3 , 0x3 , 0x3 , 0x3 , 0x3 , 0x3 , 0x3 , 0x3 , 0x3 , 0x3 , 0xff ,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 0x40 , 0x0 },		//2
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{ 0x0 , 0x0 , 0x0 , 0x0 , 0x0 , 0x0 , 0x0 , 0x0 , 0x0 , 0x0 , 0x0 , 0x0 , 0x0 ,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 0x0 , 0x0}      // Blank
};

const uint8_t smallNumbers[12][SMALLNUMbits*SMALLNUMbytes] PROGMEM = { 
{0x0 , 0xf8 , 0xfc , 0x6 , 0x6 , 0x6 , 0x6 , 0x6 , 0xfc , 0xf8 , 0x0 , 0x0 , 0x7f , 0xff , 0xc0 , 0xc0 , 0xc0 , 0xc0 , 0xc0 , 0xff , 0x7f , 0x0}, 		//0
{0x0 , 0x0 , 0x0 , 0x0 , 0x0 , 0x0 , 0x0 , 0x0 , 0xfc , 0xf8 , 0x0 , 0x0 , 0x0 , 0x0 , 0x0 , 0x0 , 0x0 , 0x0 , 0x0 , 0x7f , 0x3c , 0x0}, 				//1
{0x0 , 0x0 , 0x4 , 0x6 , 0x6 , 0x6 , 0x6 , 0x6 , 0xfc , 0xf8 , 0x0 , 0x0 , 0x7e , 0xff , 0xc3 , 0xc3 , 0xc3 , 0xc3 , 0xc3 , 0xc3 , 0x41 , 0x0},			//2
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{0x0 , 0x0 , 0x0 , 0x0 , 0xf0 , 0xf0 , 0x0 , 0x0 , 0x0 , 0x0 , 0x0 , 0x3 , 0x3 , 0x3 , 0x3 , 0x3f , 0x3f , 0x3 , 0x3 , 0x3 , 0x3 , 0x0}			        //11
};

const uint8_t bigDot[BIGNUMbits*BIGNUMbytes] PROGMEM = { 
0x0 , 0x0 , 0x0 , 0x0 , 0x0 , 0x0 , 0x0 , 0x0 , 0x0 , 0xc0 , 0xc0 , 0xc0
};

const uint8_t batIcon[5][batWIDTHbits*BATbytes] PROGMEM = { 
// 4/4 FULL
{0x7e , 0x7e , 0xff , 0x81 , 0xbd , 0xbd , 0xbd , 0xbd , 0x81 , 0xbd , 0xbd , 0xbd , 0xbd , 0x81 , 0xbd , 0xbd , 0xbd , 0xbd , 0x81 , 0xbd , 0xbd , 0xbd , 0xbd , 0x81 , 0xff},
// 3/4 FULL
{0x7e , 0x7e , 0xff , 0x81 , 0x81 , 0x81 , 0x81 , 0x81 , 0x81 , 0xbd , 0xbd , 0xbd , 0xbd , 0x81 , 0xbd , 0xbd , 0xbd , 0xbd , 0x81 , 0xbd , 0xbd , 0xbd , 0xbd , 0x81 , 0xff},
// 2/4 FULL
{0x7e , 0x7e , 0xff , 0x81 , 0x81 , 0x81 , 0x81 , 0x81 , 0x81 , 0x81 , 0x81 , 0x81 , 0x81 , 0x81 , 0xbd , 0xbd , 0xbd , 0xbd , 0x81 , 0xbd , 0xbd , 0xbd , 0xbd , 0x81 , 0xff},
// 1/4 FULL
{0x7e , 0x7e , 0xff , 0x81 , 0x81 , 0x81 , 0x81 , 0x81 , 0x81 , 0x81 , 0x81 , 0x81 , 0x81 , 0x81 , 0x81 , 0x81 , 0x81 , 0x81 , 0x81 , 0xbd , 0xbd , 0xbd , 0xbd , 0x81 , 0xff},
// 0/4 FULL
{0x7e , 0x7e , 0xff , 0x81 , 0x81 , 0x81 , 0x81 , 0x81 , 0x81 , 0x81 , 0x81 , 0x81 , 0x81 , 0x81 , 0x81 , 0x81 , 0x81 , 0x81 , 0x81 , 0x81 , 0x81 , 0x81 , 0x81 , 0x81 , 0xff}
};

const uint8_t mainBigText[3][mainWIDTHbits*MAINbytes] PROGMEM = { 
// READY
{0x0 , 0x0 , 0x80 , 0x80 , 0x80 , 0x80 , 0x80 , 0x80 , 0x80 , 0x80 , 0x80 , 0x0 , 0x0 ,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 0x0
}, 
// PLAYING
{0x0 , 0x0 , 0x80 , 0x80 , 0x80 , 0x80 , 0x80 , 0x80 , 0x80 , 0x80 , 0x80 , 0x0 , 0x0 ,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 0x0 , 0x0	}, 
// REC
{0x1 , 0x0 , 0x80 , 0x80 , 0x80 , 0x80 , 0x80 , 0x80 , 0x80 , 0x80 , 0x80 , 0x0 , 0x0 ,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 0x0 , 0x0}

}; 

const uint8_t mainSmallText[9][mainSmallWIDTHbits*MAINsmallbytes] PROGMEM = { 
{0x0 , 0x0 , 0x0 , 0x0 , 0x0 , 0x80 , 0x80 , 0x80 , 0x80 , 0x80 , 0x80 , 0x0 , 0x0 ,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 0x0 , 0x0}, //OFF
{0x0 , 0x0 , 0x0 , 0x0 , 0x0 , 0x80 , 0x80 , 0x80 , 0x80 , 0x80 , 0x80 , 0x0 , 0x0 ,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 0x0 , 0x0 }, // ON
{0x0 , 0x0 , 0x80 , 0x80 , 0x80 , 0x80 , 0x80 , 0x80 , 0x80 , 0x80 , 0x80 , 0x0 , 0x0 ,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 0x0 , 0x0 }, //REC
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{0x0 , 0x0 , 0x80 , 0x80 , 0x80 , 0x80 , 0x80 , 0x80 , 0x0 , 0x0 , 0x0 , 0x80 , 0x80 ,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 0x0 , 0x0 } //UL
};

const uint8_t vswrToOne[vswrWIDTHbits * vswrBytes] PROGMEM = {0x0 , 0x0 , 0x0 , 0x0 , 0x0 , 0x0 , 0x0 , 0x3 , 0x3 , 0xff , 0xff , 0x0 , 0x0 , 0x0 , 0x0 , 0x0 , 
0x0 , 0x70 , 0x70 , 0x70 , 0x0 , 0x0 , 0x0 , 0x0 , 0x0 , 0xff , 0xff , 0x0 , 0x0 , 0x0 , 0x0 , 0x0 , 0x0 , 0xe0 , 0xe0 , 0xe0 , 0x0 , 0x0 , 0x0 , 0xc0 , 0xc0 , 0xff , 0xff , 0xc0 , 0xc0 , 0x0 , 0x0 , 0x0};

//Convert Freq to string
void displayFreq(uint32_t freq, uint8_t bat_level) {
	int millions;
	int millions2;
	int hundredthousands;
	int tenthousands;
	int thousands;
  int hundreds;
  int tens;
	
	uint32_t newFreq = freq/4;
	newFreq -= TXOFFSET;

	millions = (int)(newFreq/10000000);
	millions2 = ((newFreq/1000000)%10);
  hundredthousands = ((newFreq/100000)%10);
  tenthousands = ((newFreq/10000)%10);
  thousands = ((newFreq/1000)%10);
  hundreds = ((newFreq/100)%10);
  tens = ((newFreq/10)%10);

	if (millions == 0) {
    drawNumberBig(11,0);
  }
  else {
    drawNumberBig(millions,0);
  }
	drawNumberBig(millions2,BIGNUMbits);
	drawNumberBig(hundredthousands,((BIGNUMbits)*2)+5);
	drawNumberBig(tenthousands,((BIGNUMbits)*3)+5);		  
	drawNumberBig(thousands,((BIGNUMbits)*4)+5);
	drawNumberSmall(hundreds,(((BIGNUMbits)*5)+5), 2);  
	drawNumberSmall(tens,(((BIGNUMbits)*5)+SMALLNUMbits+5), 2);
				
	drawDot(BIGNUMbits*2);

	drawBat(bat_level);
}

void displayFreqSmall(uint32_t rxFreq, uint32_t ritFreq) {
	int millions;
	int millions2;
	int hundredthousands;
	int tenthousands;
	int thousands;
  int hundreds;
  int tens;
  int ones;
	
	rxFreq = rxFreq/4;
	rxFreq -= TXOFFSET;	
	
	millions = (int)(rxFreq/10000000);
	millions2 = ((rxFreq/1000000)%10);
  hundredthousands = ((rxFreq/100000)%10);
  tenthousands = ((rxFreq/10000)%10);
  thousands = ((rxFreq/1000)%10);
  hundreds = ((rxFreq/100)%10);
  tens = ((rxFreq/10)%10);
     
	drawNumberSmall(millions,0,0);
	drawNumberSmall(millions2,SMALLNUMbits, 0);
	drawNumberSmall(hundredthousands,(((SMALLNUMbits)*2)+5),0);  
	drawNumberSmall(tenthousands,(((SMALLNUMbits)*3)+5),0);		
	drawNumberSmall(thousands,(((SMALLNUMbits)*4))+5,0);
	drawNumberSmall(hundreds,(((SMALLNUMbits)*5))+5,0);
	drawNumberSmall(tens,(((SMALLNUMbits)*5)+SMALLNUMbits+5),0);


	ritFreq = ritFreq/4;
	ritFreq -= TXOFFSET;	
    
	if (ritFreq > rxFreq) {
		drawNumberSmall(11,(((SMALLNUMbits)*2)+5),2);  
	}
	else if (ritFreq == rxFreq) {
	  // Do nothing
	}	
	else {
		drawNumberSmall(10,(((SMALLNUMbits)*2)+5),2);  	
	}
		
	ritFreq = abs(ritFreq - rxFreq);
	
  tenthousands = ((ritFreq/10000)%10);
  thousands = ((ritFreq/1000)%10);
  hundreds = ((ritFreq/100)%10);
  tens = ((ritFreq/10)%10);
  ones = ((ritFreq/1)%10);

	drawNumberSmall(thousands,(((SMALLNUMbits)*3)+5),2);		
	drawNumberSmall(hundreds,(((SMALLNUMbits)*4))+5,2);
	drawNumberSmall(tens,(((SMALLNUMbits)*5))+5,2);
	drawNumberSmall(ones,(((SMALLNUMbits)*5)+SMALLNUMbits+5),2);
}

void drawNumberBig(int bigNum, int offset) {
	uint16_t i;
	uint8_t j = 0;
	uint8_t k;

	for (k=1; k<4; k++) {	
		//Fill Icon into main buffer, starting at x,y -> ( (128-45) , 0 )
		for (i=0; i<BIGNUMbits; i++) {
			OLEDbuffer[(i+offset)+(SSD1306_LCDWIDTH*k)] = pgm_read_byte(&(bigNumbers[bigNum][j]));
			j++;
		}
	}	
}

void drawNumberSmall(int smallNum, int offset, int offsetRow) {
	uint16_t i;
	uint8_t j = 0;
	uint8_t k;

	for (k=offsetRow; k<(offsetRow+2); k++) {	
		//Fill Icon into main buffer, starting at x,y -> ( (128-45) , 0 )
		for (i=0; i<SMALLNUMbits; i++) {
			OLEDbuffer[(i+offset)+(SSD1306_LCDWIDTH*k)] = pgm_read_byte(&(smallNumbers[smallNum][j]));
			j++;
		}
	}	
}

void drawDot(int offset) {
	uint16_t i;
	uint8_t j = 0;
	uint8_t k;

	for (k=1; k<4; k++) {	
		//Fill Icon into main buffer, starting at x,y -> ( (128-45) , 0 )
		for (i=0; i<BIGDOTbits; i++) {
			OLEDbuffer[(i+offset)+(SSD1306_LCDWIDTH*k)] = pgm_read_byte(&(bigDot[j]));
			j++;
		}
	}	
}

void drawBat(uint8_t charge) {
	uint16_t i;
	uint8_t j = 0;
	uint8_t k;

	for (k=3; k<4; k++) 	
	{	
		//Fill Icon into main buffer, starting at x,y -> ( (128-45) , 0 )
		for (i=(SSD1306_LCDWIDTH-batWIDTHbits); i<SSD1306_LCDWIDTH; i++) 		
		{
			OLEDbuffer[i+(SSD1306_LCDWIDTH*k)] = pgm_read_byte(&(batIcon[charge][j]));
			j++;
		}
	}	
}

void drawVSWRtoOne(void) {
	uint16_t i;
	uint8_t j = 0;
	uint8_t k;

	for (k=1; k<4; k++) {	
		//Fill Icon into main buffer, starting at x,y -> ( (128-45) , 0 )
		for (i=53; i<(53+vswrWIDTHbits); i++) {
			OLEDbuffer[i+(SSD1306_LCDWIDTH*k)] = pgm_read_byte(&(vswrToOne[j]));
			j++;
		}
	}	
}

void drawMainArea(int item) {
	uint16_t i;
	uint8_t j = 0;
	uint8_t k;

	for (k=1; k<4; k++) {	
		//Fill Icon into main buffer, starting at x,y -> ( (128-45) , 0 )
		for (i=0; i<mainWIDTHbits; i++) {
			OLEDbuffer[i+(SSD1306_LCDWIDTH*k)] = pgm_read_byte(&(mainBigText[item][j]));
			j++;
		}
	}	
}

void drawMainAreaSmall(int item) {
	uint16_t i;
	uint8_t j = 0;
	uint8_t k;

	for (k=1; k<4; k++) {	
		//Fill Icon into main buffer, starting at x,y -> ( (128-45) , 0 )
		for (i=0; i<mainSmallWIDTHbits; i++) {
			OLEDbuffer[i+(SSD1306_LCDWIDTH*k)] = pgm_read_byte(&(mainSmallText[item][j]));
			j++;
		}
	}	
}

void displayChangeStateIcon(uint8_t iconNum) {
	uint16_t i;
	uint8_t j = 0;
	uint8_t k;

	for (k=0; k<2; k++) {				
		//Fill Icon into main buffer, starting at x,y -> ( (128-45) , 0 )
		for (i=(SSD1306_LCDWIDTH-ICONWIDTHbits); i<SSD1306_LCDWIDTH; i++) {
			OLEDbuffer[i+(SSD1306_LCDWIDTH*k)] = pgm_read_byte(&(stateIcons[iconNum][j]));
			j++;
		}
	}
}

void drawIntNumber(uint16_t number) {
	int thousands;
  int hundreds;
  int tens;
  int ones;

  thousands = ((number/1000)%10);
  hundreds = ((number/100)%10);
  tens = ((number/10)%10);
  ones = ((number/1)%10);
    
  if (thousands == 0) {
    drawNumberBig(11, 0);
  }
	else {
    drawNumberBig(thousands,0);
    drawNumberBig(hundreds,BIGNUMbits);
	  drawNumberBig(tens,BIGNUMbits*2);  
	  drawNumberBig(ones,BIGNUMbits*3);
    return;
  }
  if (hundreds == 0) {
    drawNumberBig(11, BIGNUMbits);
  }
  else {
	  drawNumberBig(hundreds,BIGNUMbits);    
	  drawNumberBig(tens,BIGNUMbits*2);  
	  drawNumberBig(ones,BIGNUMbits*3);
    return;	        
  }   
  if (tens == 0) {
    drawNumberBig(11, BIGNUMbits*2);
  }
  else { 
	  drawNumberBig(tens,BIGNUMbits*2);  
	  drawNumberBig(ones,BIGNUMbits*3);	
    return;        
  }    
  drawNumberBig(ones,BIGNUMbits*3);	          
}	

void clearMainArea(void) {
	uint16_t i;
	uint8_t j = 0;
	uint8_t k;

	for (k=0; k<4; k++) {	
    //Fill Icon into main buffer, starting at x,y -> ( (128-45) , 0 )
		for (i=0; i<101; i++) {
			OLEDbuffer[(i)+(SSD1306_LCDWIDTH*k)] = 0;
			j++;
		}
	}	
}

void drawVSWR(uint8_t number) {
  int tens;
  int ones;
	
  tens = ((number/10)%10);
  ones = ((number/1)%10);
   
	drawNumberBig(tens,(BIGNUMbits));
	drawDot(BIGNUMbits*2);	
	drawNumberBig(ones,((BIGNUMbits*2)+5));		
	drawVSWRtoOne();
  ssd1306Refresh();
}
